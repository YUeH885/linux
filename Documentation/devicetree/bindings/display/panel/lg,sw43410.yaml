## Documentation/devicetree/bindings/mfd/qcom,i2c-pmic.yaml
```yaml
# SPDX-License-Identifier: (GPL-2.0-only OR BSD-2-Clause)
%YAML 1.2
---
$id: http://devicetree.org/schemas/mfd/qcom,i2c-pmic.yaml#
$schema: http://devicetree.org/meta-schemas/core.yaml#

title: Qualcomm I2C PMIC core

maintainers:
  - Yuzu <yuzu23234@gmail.com>

description: |
  Qualcomm PMICs accessed over I2C expose an SPMI-style 16-bit register map.
  The core provides that regmap to platform children and demultiplexes a
  summary interrupt into the per-peripheral interrupt registers.

properties:
  compatible:
    const: qcom,i2c-pmic

  reg:
    maxItems: 1

  interrupts:
    maxItems: 1

  interrupt-controller: true

  "#interrupt-cells":
    const: 3
    description: |
      The first cell is the 8-bit peripheral address, the second is the
      interrupt bit number from 0 through 7, and the third is an IRQ_TYPE_*.

  "#address-cells":
    const: 1

  "#size-cells":
    const: 1

  pinctrl-0: true

  pinctrl-names:
    items:
      - const: default

  qcom,periph-map:
    $ref: /schemas/types.yaml#/definitions/uint32-array
    minItems: 1
    maxItems: 32
    items:
      minimum: 0
      maximum: 255
    description: |
      Peripheral addresses corresponding in order to bits in the summary
      status registers, from the least significant bit upward.

  wakeup-source: true

patternProperties:
  "^.*@[0-9a-f]+$":
    type: object
    additionalProperties: true

required:
  - compatible
  - reg
  - interrupts
  - interrupt-controller
  - "#interrupt-cells"
  - "#address-cells"
  - "#size-cells"
  - qcom,periph-map

additionalProperties: false

examples:
  - |
    #include <dt-bindings/interrupt-controller/irq.h>

    i2c {
      #address-cells = <1>;
      #size-cells = <0>;

      i2c_pmic: pmic@c {
        compatible = "qcom,i2c-pmic";
        reg = <0x0c>;
        interrupt-parent = <&spmi_bus>;
        interrupts = <0x2 0xc5 0 IRQ_TYPE_LEVEL_LOW>;
        interrupt-controller;
        #interrupt-cells = <3>;
        #address-cells = <1>;
        #size-cells = <1>;
        qcom,periph-map = <0x10 0x12 0x13 0x16>;
        wakeup-source;

        charger@1000 {
          compatible = "qcom,smb1355";
          reg = <0x1000 0x700>;
          interrupt-parent = <&i2c_pmic>;
          interrupts = <0x16 1 IRQ_TYPE_EDGE_RISING>,
                       <0x10 1 IRQ_TYPE_EDGE_RISING>,
                       <0x16 6 IRQ_TYPE_EDGE_RISING>;
          interrupt-names = "wdog-bark", "chg-state-change",
                            "temperature-change";
          qcom,hw-die-temp-mitigation;
          qcom,die-temp-threshold-degc = <90>;
          wakeup-source;
        };
      };
    };

...
```

## Documentation/devicetree/bindings/power/supply/qcom,pm8150b-charger.yaml
```yaml
# SPDX-License-Identifier: GPL-2.0-only OR BSD-2-Clause
%YAML 1.2
---
$id: http://devicetree.org/schemas/power/supply/qcom,pm8150b-charger.yaml#
$schema: http://devicetree.org/meta-schemas/core.yaml#

title: Qualcomm PM8150B SMB5 charger and Gen4 fuel gauge

maintainers:
  - Yuzu <yuzu23234@gmail.com>

description: |
  PM8150B integrates an SMB5 charger and a Gen4 fuel gauge. The driver keeps the
  battery temperature thresholds programmed by the bootloader and exposes
  telemetry through the standard battery and usb power supplies.

properties:
  compatible:
    const: qcom,pm8150b-charger

  reg:
    maxItems: 1

  interrupts:
    maxItems: 10

  interrupt-names:
    items:
      - const: chg-state-change
      - const: bat-temp
      - const: usbin-plugin
      - const: usbin-src-change
      - const: wdog-bark
      - const: soc-update
      - const: batt-temp-delta
      - const: usbin-uv
      - const: temp-change
      - const: usbin-icl-change

  io-channels:
    items:
      - description: USB input current sense
      - description: MID_CHG voltage on the USB input path

  io-channel-names:
    items:
      - const: usbin_i
      - const: mid_chg

  monitored-battery: true

  qcom,parallel-charger:
    $ref: /schemas/types.yaml#/definitions/phandle
    description: power supply of the SMB1355 parallel charger

  qcom,parallel-percent:
    minimum: 1
    maximum: 99
    description:
      Target share of the fast charge current, in percent, assigned to the
      parallel charger at normal battery temperature.

  qcom,auto-recharge-soc:
    $ref: /schemas/types.yaml#/definitions/uint32
    minimum: 0
    maximum: 100
    description:
      State of charge, in percent, at which SOC-based recharge restarts
      charging.

  qcom,wd-bark-time-secs:
    $ref: /schemas/types.yaml#/definitions/uint32
    enum: [16, 32, 64, 128]
    description:
      Watchdog bark timeout in seconds.

  qcom,wd-snarl-time-config:
    $ref: /schemas/types.yaml#/definitions/uint32
    minimum: 0
    maximum: 7
    description:
      Factory watchdog snarl timeout selector.

  qcom,hw-die-temp-mitigation:
    type: boolean
    description:
      Enable the charger die-temperature monitor and comparator. Temperature
      monitoring sources are disabled unless enabled by the corresponding
      mitigation property.

  qcom,hw-connector-mitigation:
    type: boolean
    description:
      Enable the connector-thermistor temperature monitor.

  qcom,hw-skin-temp-mitigation:
    type: boolean
    description:
      Enable the skin-thermistor temperature monitor.

  qcom,usb-c-port:
    $ref: /schemas/types.yaml#/definitions/phandle
    description:
      TCPM port providing the USB Type-C and USB Power Delivery negotiation
      result.

  wakeup-source: true

required:
  - compatible
  - reg
  - interrupts
  - interrupt-names
  - io-channels
  - io-channel-names
  - monitored-battery
  - qcom,parallel-charger
  - qcom,parallel-percent
  - qcom,auto-recharge-soc
  - qcom,usb-c-port

allOf:
  - $ref: power-supply.yaml#

additionalProperties: false

examples:
  - |
    #include <dt-bindings/interrupt-controller/irq.h>

    pmic {
      #address-cells = <1>;
      #size-cells = <0>;

      pm8150b_typec: typec {
      };

      charger@1000 {
        compatible = "qcom,pm8150b-charger";
        reg = <0x1000>;
        interrupts = <0x2 0x10 0x1 IRQ_TYPE_EDGE_RISING>,
                     <0x2 0x12 0x0 IRQ_TYPE_EDGE_RISING>,
                     <0x2 0x13 0x4 IRQ_TYPE_EDGE_BOTH>,
                     <0x2 0x13 0x6 IRQ_TYPE_EDGE_RISING>,
                     <0x2 0x16 0x1 IRQ_TYPE_EDGE_RISING>,
                     <0x2 0x40 0x0 IRQ_TYPE_EDGE_BOTH>,
                     <0x2 0x42 0x2 IRQ_TYPE_EDGE_BOTH>,
                     <0x2 0x13 0x2 IRQ_TYPE_EDGE_BOTH>,
                     <0x2 0x16 0x6 IRQ_TYPE_EDGE_BOTH>,
                     <0x2 0x13 0x7 IRQ_TYPE_EDGE_RISING>;
        interrupt-names = "chg-state-change", "bat-temp", "usbin-plugin",
                          "usbin-src-change", "wdog-bark", "soc-update",
                          "batt-temp-delta", "usbin-uv", "temp-change",
                          "usbin-icl-change";
        io-channels = <&pm8150b_adc 7>, <&pm8150b_adc 30>;
        io-channel-names = "usbin_i", "mid_chg";
        monitored-battery = <&battery>;
        qcom,hw-die-temp-mitigation;
        qcom,parallel-charger = <&smb1355>;
        qcom,parallel-percent = <70>;
        qcom,auto-recharge-soc = <98>;
        qcom,usb-c-port = <&pm8150b_typec>;
        wakeup-source;
      };
    };
```

## Documentation/devicetree/bindings/power/supply/qcom,smb1355.yaml
```yaml
# SPDX-License-Identifier: (GPL-2.0-only OR BSD-2-Clause)
%YAML 1.2
---
$id: http://devicetree.org/schemas/power/supply/qcom,smb1355.yaml#
$schema: http://devicetree.org/meta-schemas/core.yaml#

title: Qualcomm SMB1355 parallel charger

maintainers:
  - Yuzu <yuzu23234@gmail.com>

description: |
  Secondary charger sharing the main charger's MID input. Input current
  limiting belongs to the main charger; the secondary controls its FCC and
  float voltage. The main policy periodically renews the enable request.
  Hardware die-temperature mitigation and watchdog cutoff remain active
  while charging. The charger is a child of a Qualcomm I2C PMIC core, which
  provides register access and the interrupt domain.

properties:
  compatible:
    const: qcom,smb1355

  reg:
    maxItems: 1

  interrupts:
    minItems: 3
    maxItems: 3

  interrupt-names:
    items:
      - const: wdog-bark
      - const: chg-state-change
      - const: temperature-change

  qcom,hw-die-temp-mitigation:
    type: boolean
    description:
      Use the hardware die-temperature comparator instead of software scanning.

  qcom,die-temp-threshold-degc:
    $ref: /schemas/types.yaml#/definitions/uint32
    minimum: 34
    maximum: 97
    description:
      Lower die-temperature comparator threshold in degrees Celsius.

  wakeup-source: true

required:
  - compatible
  - reg
  - interrupts
  - interrupt-names

additionalProperties: false

examples:
  - |
    #include <dt-bindings/interrupt-controller/irq.h>

    i2c_pmic: i2c-pmic {
      #address-cells = <1>;
      #size-cells = <1>;
      interrupt-controller;
      #interrupt-cells = <3>;

      charger@1000 {
        compatible = "qcom,smb1355";
        reg = <0x1000 0x700>;
        interrupt-parent = <&i2c_pmic>;
        interrupts = <0x16 1 IRQ_TYPE_EDGE_RISING>,
                     <0x10 1 IRQ_TYPE_EDGE_RISING>,
                     <0x16 6 IRQ_TYPE_EDGE_RISING>;
        interrupt-names = "wdog-bark", "chg-state-change",
                          "temperature-change";
        qcom,hw-die-temp-mitigation;
        qcom,die-temp-threshold-degc = <90>;
        wakeup-source;
      };
    };

...
```

## Documentation/devicetree/bindings/pps/pps-irq.yaml
```yaml
# SPDX-License-Identifier: (GPL-2.0-only OR BSD-2-Clause)
%YAML 1.2
---
$id: http://devicetree.org/schemas/pps/pps-irq.yaml#
$schema: http://devicetree.org/meta-schemas/core.yaml#

title: PPS Signal via an Interrupt Controller

maintainers:
  - yuzu <yuzu23234@gmail.com>

description:
  A PPS signal routed to an interrupt controller. The selected interrupt edge
  is reported as a PPS assert event. Pin multiplexing is configured separately
  from interrupt delivery.
  Assert events are qualified against the configured period and jitter limit.
  Two consecutive edges matching the period and jitter limit establish the
  assert phase. Later edges must match that phase, including after missing
  pulses. A gap longer than two periods plus the jitter limit restarts phase
  acquisition.

properties:
  compatible:
    const: pps-irq

  interrupts:
    maxItems: 1

  assert-period-ns:
    minimum: 1
    description: Expected interval between assert edges, in nanoseconds.

  max-jitter-ns:
    minimum: 1
    description:
      Maximum deviation from the established assert phase, in nanoseconds.
      Must be less than half the assert period.

required:
  - compatible
  - interrupts
  - assert-period-ns
  - max-jitter-ns

additionalProperties: false

examples:
  - |
    #include <dt-bindings/interrupt-controller/irq.h>

    pps {
        compatible = "pps-irq";
        interrupt-parent = <&pdc>;
        interrupts = <60 IRQ_TYPE_EDGE_RISING>;
        assert-period-ns = <1000000000>;
        max-jitter-ns = <2000000>;
    };
```

## Documentation/devicetree/bindings/sound/ess,es9218p.yaml
```yaml
# SPDX-License-Identifier: (GPL-2.0-only OR BSD-2-Clause)
%YAML 1.2
---
$id: http://devicetree.org/schemas/sound/ess,es9218p.yaml#
$schema: http://devicetree.org/meta-schemas/core.yaml#

title: ESS ES9218P stereo DAC and headphone amplifier

maintainers:
  - Yuzu <yuzu23234@gmail.com>

allOf:
  - $ref: dai-common.yaml#

properties:
  compatible:
    const: ess,es9218p

  reg:
    maxItems: 1

  '#sound-dai-cells':
    const: 0

  power-gpios:
    maxItems: 1
    description: External power switch, active high.

  mode-gpios:
    maxItems: 1
    description: Mode selection; high with reset asserted selects bypass.

  reset-gpios:
    maxItems: 1
    description: Reset release signal, high to run the DAC.

  ess,use-internal-ldo:
    type: boolean
    description: Use the internal digital supply regulator.

required:
  - compatible
  - reg
  - '#sound-dai-cells'
  - power-gpios
  - mode-gpios
  - reset-gpios

unevaluatedProperties: false

examples:
  - |
    #include <dt-bindings/gpio/gpio.h>
    i2c {
        #address-cells = <1>;
        #size-cells = <0>;
        dac@48 {
            compatible = "ess,es9218p";
            reg = <0x48>;
            #sound-dai-cells = <0>;
            power-gpios = <&gpio 10 GPIO_ACTIVE_HIGH>;
            mode-gpios = <&gpio 9 GPIO_ACTIVE_HIGH>;
            reset-gpios = <&gpio 24 GPIO_ACTIVE_HIGH>;
            ess,use-internal-ldo;
        };
    };
```

## Documentation/devicetree/bindings/sound/nxp,tfa9872.yaml
```yaml
# SPDX-License-Identifier: (GPL-2.0-only OR BSD-2-Clause)
%YAML 1.2
---
$id: http://devicetree.org/schemas/sound/nxp,tfa9872.yaml#
$schema: http://devicetree.org/meta-schemas/core.yaml#

title: NXP TFA9872 smart amplifier with Qualcomm TFADSP

maintainers:
  - Yuzu <yuzu23234@gmail.com>

allOf:
  - $ref: dai-common.yaml#

properties:
  compatible:
    const: nxp,tfa9872

  reg:
    maxItems: 1

  '#sound-dai-cells':
    const: 0

  qcom,q6afe:
    $ref: /schemas/types.yaml#/definitions/phandle
    description: AFE service providing the secondary MI2S TFADSP interface.

  firmware-name:
    maxItems: 1
    description: TFA parameter container for this amplifier and speaker.

required:
  - compatible
  - reg
  - '#sound-dai-cells'
  - qcom,q6afe
  - firmware-name

unevaluatedProperties: false

examples:
  - |
    i2c {
        #address-cells = <1>;
        #size-cells = <0>;

        amplifier@34 {
            compatible = "nxp,tfa9872";
            reg = <0x34>;
            #sound-dai-cells = <0>;
            qcom,q6afe = <&q6afe>;
            firmware-name = "Tfa9872.cnt";
        };
    };
```

## Documentation/devicetree/bindings/sound/qcom,wcn399x.yaml
```yaml
# SPDX-License-Identifier: GPL-2.0-only OR BSD-2-Clause
%YAML 1.2
---
$id: http://devicetree.org/schemas/sound/qcom,wcn399x.yaml#
$schema: http://devicetree.org/meta-schemas/core.yaml#

title: Qualcomm WCN399x SLIMbus voice audio interface

maintainers:
  - yuzu <yuzu23234@gmail.com>

description:
  The WCN399x Bluetooth controller exposes a SLIMbus interface device at
  device index 0 and a ported audio device at device index 1. SCO audio
  uses port 0 for capture and port 16 for playback.

properties:
  compatible:
    const: slim217,220

  reg:
    items:
      - items:
          - enum: [0, 1]
          - const: 0

  slim-ifc-dev:
    $ref: /schemas/types.yaml#/definitions/phandle
    description: SLIMbus interface device used to configure audio ports.

  '#sound-dai-cells':
    const: 0

required:
  - compatible
  - reg

allOf:
  - if:
      properties:
        reg:
          items:
            - items:
                - const: 1
    then:
      required:
        - slim-ifc-dev
        - '#sound-dai-cells'

additionalProperties: false

examples:
  - |
    slim {
        #address-cells = <2>;
        #size-cells = <0>;

        wcn399x_ifd: ifd@0,0 {
            compatible = "slim217,220";
            reg = <0 0>;
        };

        codec@1,0 {
            compatible = "slim217,220";
            reg = <1 0>;
            slim-ifc-dev = <&wcn399x_ifd>;
            #sound-dai-cells = <0>;
        };
    };
```
