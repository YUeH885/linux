## Documentation/devicetree/bindings/media/i2c/sony,imx520.yaml
```yaml
# SPDX-License-Identifier: (GPL-2.0-only OR BSD-2-Clause)
%YAML 1.2
---
$id: http://devicetree.org/schemas/media/i2c/sony,imx520.yaml#
$schema: http://devicetree.org/meta-schemas/core.yaml#

title: Sony IMX520 Image Sensor

description:
  The Sony IMX520 is an 8 megapixel CMOS image sensor that outputs RAW10
  image data over a two-lane MIPI CSI-2 interface.

maintainers:
  - Linux Media Mailing List <linux-media@vger.kernel.org>

allOf:
  - $ref: /schemas/media/video-interface-devices.yaml#
  - $ref: /schemas/nvmem/nvmem-consumer.yaml#

properties:
  compatible:
    const: sony,imx520

  reg:
    maxItems: 1

  clocks:
    description: Sensor input clock.
    maxItems: 1

  reset-gpios:
    description: Active low GPIO connected to the XCLR pin.
    maxItems: 1

  mclk-request-gpios:
    description: GPIO requesting the shared camera clock path.
    maxItems: 1

  lg,camera-id:
    $ref: /schemas/types.yaml#/definitions/uint32
    description: LG camera profile identifier used by the module calibration.

  vdda-supply:
    description: Analogue power supply, 2.8 volts.

  vddd-supply:
    description: Digital core power supply, 1.05 volts.

  vddio-supply:
    description: Digital I/O power supply, 1.8 volts.

  port:
    $ref: /schemas/graph.yaml#/$defs/port-base
    additionalProperties: false

    properties:
      endpoint:
        $ref: /schemas/media/video-interfaces.yaml#
        unevaluatedProperties: false

        properties:
          data-lanes:
            items:
              - const: 1
              - const: 2

        required:
          - link-frequencies

required:
  - compatible
  - reg
  - clocks
  - reset-gpios
  - vdda-supply
  - vddd-supply
  - vddio-supply
  - port

unevaluatedProperties: false

examples:
  - |
      #include <dt-bindings/gpio/gpio.h>

      i2c {
          #address-cells = <1>;
          #size-cells = <0>;

          camera@10 {
              compatible = "sony,imx520";
              reg = <0x10>;
              clocks = <&camera_clk>;
              reset-gpios = <&gpio 12 GPIO_ACTIVE_LOW>;
              vdda-supply = <&camera_vdda>;
              vddd-supply = <&camera_vddd>;
              vddio-supply = <&camera_vddio>;

              port {
                  imx520_ep: endpoint {
                      link-frequencies = /bits/ 64 <716800000 675200000>;
                      remote-endpoint = <&csi_ep>;
                      data-lanes = <1 2>;
                  };
              };
          };
      };
...
```

## Documentation/devicetree/bindings/media/qcom,sm8150-camss.yaml
```yaml
# SPDX-License-Identifier: (GPL-2.0-only OR BSD-2-Clause)
%YAML 1.2
---
$id: http://devicetree.org/schemas/media/qcom,sm8150-camss.yaml#
$schema: http://devicetree.org/meta-schemas/core.yaml#

title: Qualcomm SM8150 Camera Subsystem (CAMSS)

maintainers:
  - Robert Foss <robert.foss@linaro.org>

description: |
  The CAMSS IP is a CSI decoder and ISP present on Qualcomm platforms.
  SM8150 integrates four CSIPHY inputs, two CSID decoders, two CSID Lite
  decoders and the corresponding VFE processing engines.

properties:
  compatible:
    const: qcom,sm8150-camss

  clocks:
    minItems: 30
    maxItems: 30

  clock-names:
    items:
      - const: cam_ahb_clk
      - const: cam_hf_axi
      - const: cam_sf_axi
      - const: camnoc_axi
      - const: camnoc_axi_src
      - const: core_ahb
      - const: cpas_ahb
      - const: csiphy0
      - const: csiphy0_timer
      - const: csiphy1
      - const: csiphy1_timer
      - const: csiphy2
      - const: csiphy2_timer
      - const: csiphy3
      - const: csiphy3_timer
      - const: slow_ahb_src
      - const: vfe0
      - const: vfe0_axi
      - const: vfe0_cphy_rx
      - const: vfe0_csid
      - const: vfe1
      - const: vfe1_axi
      - const: vfe1_cphy_rx
      - const: vfe1_csid
      - const: vfe_lite0
      - const: vfe_lite0_cphy_rx
      - const: vfe_lite0_csid
      - const: vfe_lite1
      - const: vfe_lite1_cphy_rx
      - const: vfe_lite1_csid

  interrupts:
    minItems: 12
    maxItems: 12

  interrupt-names:
    items:
      - const: csiphy0
      - const: csiphy1
      - const: csiphy2
      - const: csiphy3
      - const: csid0
      - const: csid1
      - const: csid2
      - const: csid3
      - const: vfe0
      - const: vfe1
      - const: vfe_lite0
      - const: vfe_lite1

  iommus:
    minItems: 8
    maxItems: 8

  interconnects:
    minItems: 3
    maxItems: 3

  interconnect-names:
    items:
      - const: cam_ahb
      - const: cam_hf_0_mnoc
      - const: cam_sf_0_mnoc

  power-domains:
    items:
      - description: IFE0 GDSC - Image Front End, Global Distributed Switch Controller.
      - description: IFE1 GDSC - Image Front End, Global Distributed Switch Controller.
      - description: Titan GDSC - Titan ISP Block, Global Distributed Switch Controller.

  ports:
    $ref: /schemas/graph.yaml#/properties/ports

    description:
      CSI input ports.

    properties:
      port@0:
        $ref: /schemas/graph.yaml#/$defs/port-base
        unevaluatedProperties: false
        description:
          Input port for receiving CSI data.

        properties:
          endpoint:
            $ref: video-interfaces.yaml#
            unevaluatedProperties: false

            properties:
              clock-lanes:
                maxItems: 1

              data-lanes:
                minItems: 1
                maxItems: 4

              bus-type:
                enum:
                  - 1 # MEDIA_BUS_TYPE_CSI2_CPHY
                  - 4 # MEDIA_BUS_TYPE_CSI2_DPHY

            required:
              - clock-lanes
              - data-lanes

      port@1:
        $ref: /schemas/graph.yaml#/$defs/port-base
        unevaluatedProperties: false
        description:
          Input port for receiving CSI data.

        properties:
          endpoint:
            $ref: video-interfaces.yaml#
            unevaluatedProperties: false

            properties:
              clock-lanes:
                maxItems: 1

              data-lanes:
                minItems: 1
                maxItems: 4

              bus-type:
                enum:
                  - 1 # MEDIA_BUS_TYPE_CSI2_CPHY
                  - 4 # MEDIA_BUS_TYPE_CSI2_DPHY

            required:
              - clock-lanes
              - data-lanes

      port@2:
        $ref: /schemas/graph.yaml#/$defs/port-base
        unevaluatedProperties: false
        description:
          Input port for receiving CSI data.

        properties:
          endpoint:
            $ref: video-interfaces.yaml#
            unevaluatedProperties: false

            properties:
              clock-lanes:
                maxItems: 1

              data-lanes:
                minItems: 1
                maxItems: 4

              bus-type:
                enum:
                  - 1 # MEDIA_BUS_TYPE_CSI2_CPHY
                  - 4 # MEDIA_BUS_TYPE_CSI2_DPHY

            required:
              - clock-lanes
              - data-lanes

      port@3:
        $ref: /schemas/graph.yaml#/$defs/port-base
        unevaluatedProperties: false
        description:
          Input port for receiving CSI data.

        properties:
          endpoint:
            $ref: video-interfaces.yaml#
            unevaluatedProperties: false

            properties:
              clock-lanes:
                maxItems: 1

              data-lanes:
                minItems: 1
                maxItems: 4

              bus-type:
                enum:
                  - 1 # MEDIA_BUS_TYPE_CSI2_CPHY
                  - 4 # MEDIA_BUS_TYPE_CSI2_DPHY

            required:
              - clock-lanes
              - data-lanes

  reg:
    minItems: 12
    maxItems: 12

  reg-names:
    items:
      - const: csiphy0
      - const: csiphy1
      - const: csiphy2
      - const: csiphy3
      - const: csid0
      - const: csid1
      - const: csid2
      - const: csid3
      - const: vfe0
      - const: vfe1
      - const: vfe_lite0
      - const: vfe_lite1

  vdda-phy-supply:
    description:
      0.88V supply to CSIPHY IP blocks.

  vdda-pll-supply:
    description:
      1.2V supply to CSIPHY IP blocks.

required:
  - clock-names
  - clocks
  - compatible
  - interconnects
  - interconnect-names
  - interrupts
  - interrupt-names
  - iommus
  - power-domains
  - reg
  - reg-names
  - vdda-phy-supply
  - vdda-pll-supply

additionalProperties: false
...
```

## Documentation/devicetree/bindings/media/qcom,sm8150-iris-cp-nonpixel.yaml
```yaml
# SPDX-License-Identifier: (GPL-2.0 OR BSD-2-Clause)
%YAML 1.2
---
$id: http://devicetree.org/schemas/media/qcom,sm8150-iris-cp-nonpixel.yaml#
$schema: http://devicetree.org/meta-schemas/core.yaml#

title: Qualcomm SM8150 Iris protected non-pixel context

maintainers:
  - Dikshita Agarwal <dikshita.agarwal@oss.qualcomm.com>

description: |
  The Iris encoder uses a protected auto register programming buffer,
  including for non-secure video sessions. This child of the Iris device
  describes its separate SMMU context for CP non-pixel transactions.

properties:
  compatible:
    const: qcom,sm8150-iris-cp-nonpixel

  iommus:
    maxItems: 1

required:
  - compatible
  - iommus

additionalProperties: false

examples:
  - |
    cp-nonpixel {
        compatible = "qcom,sm8150-iris-cp-nonpixel";
        iommus = <&apps_smmu 0x2304 0x60>;
    };
```

## Documentation/devicetree/bindings/media/qcom,sm8150-iris.yaml
```yaml
# SPDX-License-Identifier: (GPL-2.0 OR BSD-2-Clause)
%YAML 1.2
---
$id: http://devicetree.org/schemas/media/qcom,sm8150-iris.yaml#
$schema: http://devicetree.org/meta-schemas/core.yaml#

title: Qualcomm SM8150 Iris video encode and decode accelerators

maintainers:
  - Dikshita Agarwal <dikshita.agarwal@oss.qualcomm.com>

description:
  The Iris v1.xx IP is a video encode and decode accelerator present on
  Qualcomm SM8150 platforms.

properties:
  compatible:
    const: qcom,sm8150-iris

  reg:
    maxItems: 1

  power-domains:
    items:
      - description: Venus controller GDSC
      - description: VCODEC0 core GDSC
      - description: VCODEC1 CVP GDSC
      - description: MX performance domain
      - description: MMCX performance domain

  power-domain-names:
    items:
      - const: venus
      - const: vcodec0
      - const: vcodec1
      - const: mx
      - const: mmcx

  clocks:
    items:
      - description: Video AXIC clock
      - description: Video codec0 AXI clock
      - description: Video codec1 AXI clock
      - description: Video core clock
      - description: Video AHB clock
      - description: Video codec0 core clock
      - description: Video codec1 core clock

  clock-names:
    items:
      - const: iface
      - const: vcodec0_axi
      - const: vcodec1_axi
      - const: core
      - const: ahb
      - const: vcodec0_core
      - const: vcodec1_core

  interrupts:
    maxItems: 1

  interconnects:
    items:
      - description: CPU configuration bus
      - description: Video memory bus

  interconnect-names:
    items:
      - const: cpu-cfg
      - const: video-mem

  iommus:
    maxItems: 1

  memory-region:
    items:
      - description: Firmware memory
      - description: Reserved low IOVA range for protected video buffers

  firmware-name:
    maxItems: 1

  operating-points-v2: true

  opp-table:
    type: object

  cp-nonpixel:
    $ref: qcom,sm8150-iris-cp-nonpixel.yaml#

  resets:
    items:
      - description: Video bus reset
      - description: Video core reset
      - description: Video codec0 AXI reset
      - description: Video codec1 AXI reset

  reset-names:
    items:
      - const: bus
      - const: core
      - const: vcodec0
      - const: vcodec1

required:
  - compatible
  - reg
  - power-domains
  - power-domain-names
  - clocks
  - clock-names
  - interrupts
  - interconnects
  - interconnect-names
  - iommus
  - memory-region
  - operating-points-v2
  - resets
  - reset-names
  - cp-nonpixel

additionalProperties: false

examples:
  - |
    #include <dt-bindings/interrupt-controller/arm-gic.h>
    #include <dt-bindings/clock/qcom,gcc-sm8150.h>
    #include <dt-bindings/clock/qcom,videocc-sm8150.h>
    #include <dt-bindings/interconnect/qcom,sm8150.h>
    #include <dt-bindings/power/qcom,rpmhpd.h>

    video-codec@aa00000 {
        compatible = "qcom,sm8150-iris";
        reg = <0x0aa00000 0x100000>;
        interrupts = <GIC_SPI 174 IRQ_TYPE_LEVEL_HIGH>;

        power-domains = <&videocc VENUS_GDSC>,
                        <&videocc VCODEC0_GDSC>,
                        <&videocc VCODEC1_GDSC>,
                        <&rpmhpd SM8150_MX>,
                        <&rpmhpd SM8150_MMCX>;
        power-domain-names = "venus", "vcodec0", "vcodec1", "mx", "mmcx";

        clocks = <&gcc GCC_VIDEO_AXIC_CLK>,
                 <&gcc GCC_VIDEO_AXI0_CLK>,
                 <&gcc GCC_VIDEO_AXI1_CLK>,
                 <&videocc VIDEO_CC_MVSC_CORE_CLK>,
                 <&videocc VIDEO_CC_IRIS_AHB_CLK>,
                 <&videocc VIDEO_CC_MVS0_CORE_CLK>,
                 <&videocc VIDEO_CC_MVS1_CORE_CLK>;
        clock-names = "iface", "vcodec0_axi", "vcodec1_axi", "core",
                      "ahb", "vcodec0_core", "vcodec1_core";

        interconnects = <&gem_noc MASTER_AMPSS_M0 0 &config_noc SLAVE_VENUS_CFG 0>,
                        <&mmss_noc MASTER_VIDEO_P0 0 &mc_virt SLAVE_EBI_CH0 0>;
        interconnect-names = "cpu-cfg", "video-mem";

        iommus = <&apps_smmu 0x2300 0x60>;
        memory-region = <&venus_mem>, <&video_iova_reserved>;

        resets = <&gcc GCC_VIDEO_AXIC_CLK_BCR>,
                 <&videocc VIDEO_CC_MVSC_CORE_CLK_BCR>,
                 <&gcc GCC_VIDEO_AXI0_CLK_BCR>,
                 <&gcc GCC_VIDEO_AXI1_CLK_BCR>;
        reset-names = "bus", "core", "vcodec0", "vcodec1";

        operating-points-v2 = <&iris_opp_table>;

        cp-nonpixel {
            compatible = "qcom,sm8150-iris-cp-nonpixel";
            iommus = <&apps_smmu 0x2304 0x60>;
        };

        iris_opp_table: opp-table {
            compatible = "operating-points-v2";

            opp-240000000 {
                opp-hz = /bits/ 64 <240000000>;
                required-opps = <&rpmhpd_opp_low_svs>,
                                <&rpmhpd_opp_low_svs>;
            };

            opp-338000000 {
                opp-hz = /bits/ 64 <338000000>;
                required-opps = <&rpmhpd_opp_svs>,
                                <&rpmhpd_opp_svs>;
            };

            opp-365000000 {
                opp-hz = /bits/ 64 <365000000>;
                required-opps = <&rpmhpd_opp_svs_l1>,
                                <&rpmhpd_opp_svs_l1>;
            };

            opp-444000000 {
                opp-hz = /bits/ 64 <444000000>;
                required-opps = <&rpmhpd_opp_nom>,
                                <&rpmhpd_opp_nom>;
            };

            opp-533000000 {
                opp-hz = /bits/ 64 <533000000>;
                required-opps = <&rpmhpd_opp_turbo>,
                                <&rpmhpd_opp_turbo>;
            };
        };
    };
```
