## Documentation/devicetree/bindings/display/panel/lg,sw43410.yaml
```yaml
# SPDX-License-Identifier: (GPL-2.0-only OR BSD-2-Clause)
%YAML 1.2
---
$id: http://devicetree.org/schemas/display/panel/lg,sw43410.yaml#
$schema: http://devicetree.org/meta-schemas/core.yaml#

title: LG SW43410 AMOLED DDIC

maintainers:
  - Yuzu <yuzu23234@gmail.com>

description:
  SW43410 是带 DSC 支持的 AMOLED 面板显示驱动 IC。

allOf:
  - $ref: panel-common.yaml#

properties:
  compatible:
    const: lg,sw43410

  reg:
    maxItems: 1

  port: true
  vddi-supply: true
  vpnl-supply: true
  reset-gpios: true

required:
  - compatible
  - reg
  - port
  - vddi-supply
  - vpnl-supply
  - reset-gpios

additionalProperties: false

examples:
  - |
    #include <dt-bindings/gpio/gpio.h>

    dsi {
        #address-cells = <1>;
        #size-cells = <0>;

        panel@0 {
            compatible = "lg,sw43410";
            reg = <0>;

            vddi-supply = <&vreg_l14a_1p8>;
            vpnl-supply = <&vreg_l17a_3p0>;
            reset-gpios = <&tlmm 6 GPIO_ACTIVE_LOW>;

            port {
                endpoint {
                    remote-endpoint = <&mdss_dsi0_out>;
                };
            };
        };
    };
...
```

## Documentation/devicetree/bindings/input/dongwoon,dw7800.yaml
```yaml
# SPDX-License-Identifier: (GPL-2.0-only OR BSD-2-Clause)
%YAML 1.2
---
$id: http://devicetree.org/schemas/input/dongwoon,dw7800.yaml#
$schema: http://devicetree.org/meta-schemas/core.yaml#

title: Dongwoon Anatech DW7800 Haptic Driver

maintainers:
  - Yuzu <yuzu23234@gmail.com>

description:
  Dongwoon Anatech DW7800 I2C haptic vibrator driver with internal FIFO
  and force-feedback rumble support.

properties:
  compatible:
    const: dongwoon,dw7800

  reg:
    maxItems: 1

  dongwoon,vpwr-on:
    $ref: /schemas/types.yaml#/definitions/uint32
    description: Power configuration indicator from vendor DTS.

required:
  - compatible
  - reg

additionalProperties: false

examples:
  - |
    i2c {
        #address-cells = <1>;
        #size-cells = <0>;

        vibrator@59 {
            compatible = "dongwoon,dw7800";
            reg = <0x59>;
        };
    };
```

## Documentation/devicetree/bindings/input/touchscreen/lg,sw42000.yaml
```yaml
# SPDX-License-Identifier: (GPL-2.0-only OR BSD-2-Clause)
%YAML 1.2
---
$id: http://devicetree.org/schemas/input/touchscreen/lg,sw42000.yaml#
$schema: http://devicetree.org/meta-schemas/core.yaml#

title: LG SW42000 触摸屏控制器

maintainers:
  - Yuzu <yuzu23234@gmail.com>

properties:
  compatible:
    const: lg,sw42000

  reg:
    maxItems: 1

  interrupts:
    maxItems: 1

  panel: true

  reset-gpios:
    maxItems: 1

  vcl-supply: true

  vdd-supply: true

required:
  - compatible
  - reg
  - interrupts
  - panel
  - reset-gpios
  - vcl-supply
  - vdd-supply

allOf:
  - $ref: touchscreen.yaml#

unevaluatedProperties: false

examples:
  - |
    #include <dt-bindings/gpio/gpio.h>
    #include <dt-bindings/interrupt-controller/irq.h>

    i2c {
        #address-cells = <1>;
        #size-cells = <0>;

        touchscreen@28 {
            compatible = "lg,sw42000";
            reg = <0x28>;
            interrupt-parent = <&gpio>;
            interrupts = <122 IRQ_TYPE_LEVEL_LOW>;
            panel = <&panel>;
            reset-gpios = <&gpio 54 GPIO_ACTIVE_LOW>;
            vcl-supply = <&touch_vcl>;
            vdd-supply = <&touch_vdd>;
            touchscreen-size-x = <1440>;
            touchscreen-size-y = <3120>;
        };
    };
```

## Documentation/devicetree/bindings/media/i2c/infineon,irs2381c.yaml
```yaml
# SPDX-License-Identifier: (GPL-2.0-only OR BSD-2-Clause)
%YAML 1.2
---
$id: http://devicetree.org/schemas/media/i2c/infineon,irs2381c.yaml#
$schema: http://devicetree.org/meta-schemas/core.yaml#

title: Infineon REAL3 IRS2381C 3D Time-of-Flight Image Sensor

description:
  The Infineon REAL3 IRS2381C is an HQVGA (224x172) 3D Time-of-Flight (ToF)
  image sensor that outputs raw depth and amplitude data over a two-lane
  MIPI CSI-2 interface.

maintainers:
  - Linux Media Mailing List <linux-media@vger.kernel.org>

allOf:
  - $ref: /schemas/media/video-interface-devices.yaml#

properties:
  compatible:
    const: infineon,irs2381c

  reg:
    maxItems: 1

  clocks:
    description: Sensor input clock (typically 24 MHz).
    maxItems: 1

  reset-gpios:
    description: Active low GPIO connected to the hardware reset pin.
    maxItems: 1

  vdda-supply:
    description: Sensor analogue / illumination power supply (3.3 volts).

  vddd-supply:
    description: Sensor digital core power supply (3.3 volts).

  vddio-supply:
    description: Sensor digital I/O power supply (1.8 volts).

  power-domains:
    maxItems: 1

  orientation: true
  rotation: true

  port:
    $ref: /schemas/graph.yaml#/$defs/port-base
    additionalProperties: false

    properties:
      endpoint:
        $ref: /schemas/media/video-interfaces.yaml#
        unevaluatedProperties: false

        properties:
          data-lanes:
            items:
              - const: 1
              - const: 2

        required:
          - link-frequencies

required:
  - compatible
  - reg
  - clocks
  - reset-gpios
  - vdda-supply
  - vddd-supply
  - vddio-supply
  - port

unevaluatedProperties: false

examples:
  - |
      #include <dt-bindings/gpio/gpio.h>

      i2c {
          #address-cells = <1>;
          #size-cells = <0>;

          camera@3d {
              compatible = "infineon,irs2381c";
              reg = <0x3d>;
              clocks = <&camcc 3>;
              reset-gpios = <&tlmm 23 GPIO_ACTIVE_LOW>;
              vdda-supply = <&camera_tof_illu_vdd>;
              vddd-supply = <&camera_tof_vdd>;
              vddio-supply = <&vreg_l8c_1p8>;
              orientation = <0>;
              rotation = <270>;

              port {
                  irs2381c_ep: endpoint {
                      link-frequencies = /bits/ 64 <300000000>;
                      remote-endpoint = <&csiphy3_ep>;
                      data-lanes = <1 2>;
                  };
              };
          };
      };
...
```

## Documentation/devicetree/bindings/media/i2c/onnn,lc898124ep1.yaml
```yaml
# SPDX-License-Identifier: (GPL-2.0-only OR BSD-2-Clause)
%YAML 1.2
---
$id: http://devicetree.org/schemas/media/i2c/onnn,lc898124ep1.yaml#
$schema: http://devicetree.org/meta-schemas/core.yaml#

title: onsemi LC898124EP1 optical image stabilization controller

maintainers:
  - yuzu <yuzu23234@gmail.com>

properties:
  compatible:
    const: onnn,lc898124ep1

  reg:
    maxItems: 1

  vdd-supply:
    description: Controller power supply.

  vio-supply:
    description: I2C I/O supply.

  vmotor-supply:
    description: Motor power supply.

  nvmem-cells:
    maxItems: 1
    description: Module VCM version used to select the DSP firmware.

  nvmem-cell-names:
    const: vcm-version

required:
  - compatible
  - reg
  - vdd-supply
  - vio-supply
  - vmotor-supply
  - nvmem-cells
  - nvmem-cell-names

additionalProperties: false

examples:
  - |
    i2c {
        #address-cells = <1>;
        #size-cells = <0>;

        ois@3e {
            compatible = "onnn,lc898124ep1";
            reg = <0x3e>;
            vdd-supply = <&vreg_ois>;
            vio-supply = <&vreg_io>;
            vmotor-supply = <&vreg_motor>;
            nvmem-cells = <&vcm_version>;
            nvmem-cell-names = "vcm-version";
        };
    };
```

## Documentation/devicetree/bindings/media/i2c/onnn,lc898219xi.yaml
```yaml
# SPDX-License-Identifier: (GPL-2.0-only OR BSD-2-Clause)
%YAML 1.2
---
$id: http://devicetree.org/schemas/media/i2c/onnn,lc898219xi.yaml#
$schema: http://devicetree.org/meta-schemas/core.yaml#

title: onsemi LC898219XI lens actuator

maintainers:
  - yuzu <yuzu23234@gmail.com>

description:
  I2C lens actuator with a 12-bit position register.

properties:
  compatible:
    const: onnn,lc898219xi

  reg:
    maxItems: 1

  vdd-supply:
    description: Actuator power supply.

  vio-supply:
    description: I2C I/O supply.

  onnn,temperature-shift:
    $ref: /schemas/types.yaml#/definitions/uint32
    enum: [0, 1, 3]
    description:
      Module-specific left shift of the initial temperature sample before
      writing the temperature compensation registers.

required:
  - compatible
  - reg
  - vdd-supply
  - vio-supply
  - onnn,temperature-shift

additionalProperties: false

examples:
  - |
    i2c {
        #address-cells = <1>;
        #size-cells = <0>;

        lens@72 {
            compatible = "onnn,lc898219xi";
            reg = <0x72>;
            vdd-supply = <&vreg_af>;
            vio-supply = <&vreg_io>;
            onnn,temperature-shift = <0>;
        };
    };
...
```

## Documentation/devicetree/bindings/media/i2c/sony,imx351.yaml
```yaml
# SPDX-License-Identifier: (GPL-2.0-only OR BSD-2-Clause)
%YAML 1.2
---
$id: http://devicetree.org/schemas/media/i2c/sony,imx351.yaml#
$schema: http://devicetree.org/meta-schemas/core.yaml#

title: Sony IMX351 Image Sensor

description:
  The Sony IMX351 is a 16 megapixel CMOS image sensor that outputs RAW10
  image data over a four-lane MIPI CSI-2 interface.

maintainers:
  - Linux Media Mailing List <linux-media@vger.kernel.org>

allOf:
  - $ref: /schemas/media/video-interface-devices.yaml#
  - $ref: /schemas/nvmem/nvmem-consumer.yaml#

properties:
  compatible:
    const: sony,imx351

  reg:
    maxItems: 1

  clocks:
    description: Sensor input clock.
    maxItems: 1

  reset-gpios:
    description: Active low GPIO connected to the XCLR pin.
    maxItems: 1

  lg,camera-id:
    $ref: /schemas/types.yaml#/definitions/uint32
    description: LG camera profile identifier used by the module calibration.

  vdda-supply:
    description: Analogue power supply, 2.8 volts.

  vddd-supply:
    description: Digital core power supply, 1.05 volts.

  vddio-supply:
    description: Digital I/O power supply, 1.8 volts.

  port:
    $ref: /schemas/graph.yaml#/$defs/port-base
    additionalProperties: false

    properties:
      endpoint:
        $ref: /schemas/media/video-interfaces.yaml#
        unevaluatedProperties: false

        properties:
          data-lanes:
            items:
              - const: 1
              - const: 2
              - const: 3
              - const: 4

        required:
          - link-frequencies

required:
  - compatible
  - reg
  - clocks
  - reset-gpios
  - vdda-supply
  - vddd-supply
  - vddio-supply
  - port

unevaluatedProperties: false

examples:
  - |
      #include <dt-bindings/gpio/gpio.h>

      i2c {
          #address-cells = <1>;
          #size-cells = <0>;

          camera@1a {
              compatible = "sony,imx351";
              reg = <0x1a>;
              clocks = <&camera_clk>;
              reset-gpios = <&gpio 30 GPIO_ACTIVE_LOW>;
              vdda-supply = <&camera_vdda>;
              vddd-supply = <&camera_vddd>;
              vddio-supply = <&camera_vddio>;

              port {
                  imx351_ep: endpoint {
                      link-frequencies = /bits/ 64 <664800000 510000000>;
                      remote-endpoint = <&csi_ep>;
                      data-lanes = <1 2 3 4>;
                  };
              };
          };
      };
...
```

## Documentation/devicetree/bindings/media/i2c/sony,imx363.yaml
```yaml
# SPDX-License-Identifier: (GPL-2.0-only OR BSD-2-Clause)
%YAML 1.2
---
$id: http://devicetree.org/schemas/media/i2c/sony,imx363.yaml#
$schema: http://devicetree.org/meta-schemas/core.yaml#

title: Sony IMX363 Image Sensor

description:
  The Sony IMX363 is a 12 megapixel CMOS image sensor that outputs RAW10
  image data over a four-lane MIPI CSI-2 interface.

maintainers:
  - Linux Media Mailing List <linux-media@vger.kernel.org>

allOf:
  - $ref: /schemas/media/video-interface-devices.yaml#
  - $ref: /schemas/nvmem/nvmem-consumer.yaml#

properties:
  compatible:
    const: sony,imx363

  reg:
    maxItems: 1

  clocks:
    description: Sensor input clock.
    maxItems: 1

  reset-gpios:
    description: Active low GPIO connected to the XCLR pin.
    maxItems: 1

  lg,camera-id:
    $ref: /schemas/types.yaml#/definitions/uint32
    description: LG camera profile identifier used by the module calibration.

  ois:
    $ref: /schemas/types.yaml#/definitions/phandle
    description: Optical image stabilization controller for the module.

  vddaux-supply:
    description: Module auxiliary power supply, 1.8 volts.

  vdda-supply:
    description: Analogue power supply, 2.8 volts.

  vddd-supply:
    description: Digital core power supply, 1.05 volts.

  vddio-supply:
    description: Digital I/O power supply, 1.8 volts.

  port:
    $ref: /schemas/graph.yaml#/$defs/port-base
    additionalProperties: false

    properties:
      endpoint:
        $ref: /schemas/media/video-interfaces.yaml#
        unevaluatedProperties: false

        properties:
          data-lanes:
            items:
              - const: 1
              - const: 2
              - const: 3
              - const: 4

        required:
          - link-frequencies

required:
  - compatible
  - reg
  - clocks
  - reset-gpios
  - vddaux-supply
  - vdda-supply
  - vddd-supply
  - vddio-supply
  - port

unevaluatedProperties: false

examples:
  - |
      #include <dt-bindings/gpio/gpio.h>

      i2c {
          #address-cells = <1>;
          #size-cells = <0>;

          camera@10 {
              compatible = "sony,imx363";
              reg = <0x10>;
              clocks = <&camera_clk>;
              reset-gpios = <&gpio 28 GPIO_ACTIVE_LOW>;
              vddaux-supply = <&vreg_1p8>;
              vdda-supply = <&vreg_2p8>;
              vddd-supply = <&vreg_1p05>;
              vddio-supply = <&vreg_1p8>;

              port {
                  endpoint {
                      data-lanes = <1 2 3 4>;
                      link-frequencies = /bits/ 64 <678400000>;
                      remote-endpoint = <&mipi_csi2_ep>;
                  };
              };
          };
      };
...
```
