## Documentation/devicetree/bindings/sound/siliconmitus,sma6101.yaml
```yaml
# SPDX-License-Identifier: (GPL-2.0-only OR BSD-2-Clause)
%YAML 1.2
---
$id: http://devicetree.org/schemas/sound/siliconmitus,sma6101.yaml#
$schema: http://devicetree.org/meta-schemas/core.yaml#

title: Silicon Mitus SMA6101 Audio Amplifier and Screen Sounder

maintainers:
  - Yuzu <yuzu23234@gmail.com>

description:
  Silicon Mitus SMA6101 boosted class-D audio amplifier and piezoelectric
  screen sounder driver.

allOf:
  - $ref: dai-common.yaml#

properties:
  compatible:
    const: siliconmitus,sma6101

  reg:
    maxItems: 1

  '#sound-dai-cells':
    const: 0

  reset-gpios:
    maxItems: 1

  sm,reset-gpio:
    $ref: /schemas/types.yaml#/definitions/phandle-array
    description: Vendor reset GPIO property for compatibility.

  interrupts:
    maxItems: 1

  sys-clk-id:
    $ref: /schemas/types.yaml#/definitions/uint32
    enum: [0, 1, 2, 3]
    description: Clock source (0=19.2MHz, 1=24.576MHz, 2=PLL MCLK, 3=PLL BCLK).

  init-vol:
    $ref: /schemas/types.yaml#/definitions/uint32
    description: Initial speaker volume register value.

  stereo-two-chip:
    type: boolean
    description: Configure amplifier for two-chip stereo playback.

  registers-of-eq:
    $ref: /schemas/types.yaml#/definitions/uint32-matrix
    description: Pairs of register address and value for EQ configuration.
    items:
      items:
        - description: Register offset
        - description: Register value

  registers-of-bo:
    $ref: /schemas/types.yaml#/definitions/uint32-matrix
    description: Pairs of register address and value for brownout protection.
    items:
      items:
        - description: Register offset
        - description: Register value

required:
  - compatible
  - reg
  - '#sound-dai-cells'

unevaluatedProperties: false

examples:
  - |
    #include <dt-bindings/interrupt-controller/irq.h>
    #include <dt-bindings/gpio/gpio.h>

    i2c {
        #address-cells = <1>;
        #size-cells = <0>;

        amplifier@1e {
            compatible = "siliconmitus,sma6101";
            reg = <0x1e>;
            #sound-dai-cells = <0>;
            reset-gpios = <&tlmm 135 GPIO_ACTIVE_HIGH>;
            interrupt-parent = <&tlmm>;
            interrupts = <125 IRQ_TYPE_LEVEL_LOW>;
            sys-clk-id = <3>;
            init-vol = <0x30>;
            stereo-two-chip;
            registers-of-eq = <0x40 0x00>, <0x41 0x00>;
            registers-of-bo = <0x05 0xb8>, <0x06 0x38>;
        };
    };
```

## Documentation/devicetree/bindings/usb/lg,lge-sbu-mux.yaml
```yaml
# SPDX-License-Identifier: (GPL-2.0-only OR BSD-2-Clause)
%YAML 1.2
---
$id: http://devicetree.org/schemas/usb/lg,lge-sbu-mux.yaml#
$schema: http://devicetree.org/meta-schemas/core.yaml#

title: LGE Alpha USB-C SBU mux

maintainers:
  - yuzu <yuzu23234@gmail.com>

description:
  The LGE Alpha boards use GPIO87 to select the SBU routing and GPIO35 to
  select the USB-UART/debug path.  GPIO42 enables the DP AUX switch between
  the SBU pins and the DP controller, and GPIO148 selects its polarity.  Some
  board revisions have an additional output-enable or LDO-enable GPIO.

properties:
  compatible:
    const: lg,lge-sbu-mux

  select-gpios:
    description: GPIO87 SBU routing select.
    maxItems: 1

  uart-sel-gpios:
    description: GPIO35 USB-UART/debug routing select.
    maxItems: 1

  aux-enable-gpios:
    description: GPIO42 DP AUX switch enable.
    maxItems: 1

  aux-select-gpios:
    description: GPIO148 DP AUX switch polarity select. The asserted state
      selects the reversed connector orientation.
    maxItems: 1

  oe-gpios:
    description: Optional SBU switch output-enable GPIO. The logical high
      state disables the switch.
    maxItems: 1

  lg,reverse-sbu-switch:
    description: Invert the SBU select level for this board revision.
    type: boolean

  mode-switch: true
  orientation-switch: true
  pinctrl-names: true
  pinctrl-0: true

  port:
    $ref: /schemas/graph.yaml#/properties/port

required:
  - compatible
  - select-gpios
  - mode-switch
  - orientation-switch
  - port

allOf:
  - $ref: usb-switch.yaml#
  - $ref: usb-switch-ports.yaml#

additionalProperties: false

examples:
  - |
    #include <dt-bindings/gpio/gpio.h>

    sbu-mux {
        compatible = "lg,lge-sbu-mux";
        select-gpios = <&tlmm 87 GPIO_ACTIVE_HIGH>;
        uart-sel-gpios = <&tlmm 35 GPIO_ACTIVE_HIGH>;
        aux-enable-gpios = <&tlmm 42 GPIO_ACTIVE_LOW>;
        aux-select-gpios = <&tlmm 148 GPIO_ACTIVE_HIGH>;
        mode-switch;
        orientation-switch;

        port {
            sbu_mux_in: endpoint {
                remote-endpoint = <&typec_sbu_out>;
            };
        };
    };
```

## drivers/pps/clients/Kconfig
```kconfig
# SPDX-License-Identifier: GPL-2.0-only
#
# PPS clients configuration
#

comment "PPS clients support"

config PPS_CLIENT_KTIMER
	tristate "Kernel timer client (Testing client, use for debug)"
	help
	  If you say yes here you get support for a PPS debugging client
	  which uses a kernel timer to generate the PPS signal.

	  This driver can also be built as a module.  If so, the module
	  will be called pps-ktimer.

config PPS_CLIENT_LDISC
	tristate "PPS line discipline"
	depends on TTY
	help
	  If you say yes here you get support for a PPS source connected
	  with the CD (Carrier Detect) pin of your serial port.

config PPS_CLIENT_PARPORT
	tristate "Parallel port PPS client"
	depends on PARPORT
	help
	  If you say yes here you get support for a PPS source connected
	  with the interrupt pin of your parallel port.

config PPS_CLIENT_GPIO
	tristate "PPS client using GPIO"
	help
	  If you say yes here you get support for a PPS source using
	  GPIO. To be useful you must also register a platform device
	  specifying the GPIO pin and other options, usually in your board
	  setup.

config PPS_CLIENT_IRQ
	tristate "PPS client using an interrupt"
	depends on OF
	help
	  Capture PPS events from an interrupt controller. This supports
	  signals routed directly to an interrupt without a GPIO consumer.
	  Select a single rising or falling edge in the device tree.
	  Configure the expected assert period and allowed phase jitter.
	  The driver is called pps-irq when built as a module.

config PPS_CLIENT_IRQ_KUNIT_TEST
	tristate "PPS interrupt phase qualification tests" if !KUNIT_ALL_TESTS
	depends on KUNIT
	default KUNIT_ALL_TESTS
	help
	  Test phase acquisition, comparator wraparound pulses, missing
	  pulses, jitter limits and recovery after an output interruption
	  or a phase change with continuous rejected edges.
	  The tests run without PPS hardware or an interrupt controller.
	  This suite is called pps-irq-phase.
```
